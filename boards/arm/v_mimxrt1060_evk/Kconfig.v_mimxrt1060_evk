## boards/arm/v_mimxrt1060_evk/Kconfig.v_mimxrt1060_evk
```kconfig
# Copyright 2024 NXP
# SPDX-License-Identifier: Apache-2.0

config BOARD_MIMXRT1060_EVKB
	bool
	default y
	select SOC_PART_NUMBER_MIMXRT1062DVL6A

config SOC_MIMXRT1062
	bool
	default y
```

## boards/arm/v_mimxrt1060_evk/board.yml
```yaml
boards:
  - name: v_mimxrt1060_evk
    vendor: nxp
    socs:
      - name: mimxrt1062
```

## boards/arm/v_mimxrt1060_evk/v_mimxrt1060_evk_defconfig
```kconfig
#
# Copyright (c) 2022, Whisper.ai
#
# SPDX-License-Identifier: Apache-2.0
#

CONFIG_CONSOLE=y
CONFIG_UART_CONSOLE=y
CONFIG_SERIAL=y
CONFIG_GPIO=y
CONFIG_ARM_MPU=y
CONFIG_HW_STACK_PROTECTION=y
CONFIG_PINCTRL=y
CONFIG_I2C=y
CONFIG_FLASH=y
CONFIG_ADC=y
CONFIG_RTC=y
CONFIG_PWM=y

## display
# CONFIG_DISPLAY=y
# CONFIG_DISPLAY_LOG_LEVEL_ERR=y
# CONFIG_DMA=y
# CONFIG_MCUX_ELCDIF_PXP=y
# CONFIG_MCUX_ELCDIF_PXP_ROTATE_270=y

# power menagement
# CONFIG_VERYARK_DRIVER=y
# CONFIG_VERYARK_PM=y
# CONFIG_VERYARK_PM_HOLD=y
# CONFIG_VERYARK_PM_EXT_POWER=y
# CONFIG_VERYARK_PM_CHARGE_DETECTION=y
# CONFIG_VERYARK_PM_DISCHARGE_INDICATOR=y
# CONFIG_REBOOT=y
# CONFIG_FS_FATFS_LFN_MODE_HEAP=y
# CONFIG_FS_FATFS_REENTRANT=y

## uart setting
CONFIG_UART_INTERRUPT_DRIVEN=y
CONFIG_UART_ASYNC_API=y

# system
CONFIG_CONSOLE=y
# CONFIG_INPUT=y
# CONFIG_INIT_STACKS=y
# CONFIG_RING_BUFFER=y
CONFIG_POSIX_API=y

## loging
CONFIG_LOG=y
# CONFIG_LOG_PROCESS_THREAD_SLEEP_MS=10
# CONFIG_LOG_PROCESS_THREAD_STACK_SIZE=8192
# CONFIG_LOG_BACKEND_UART=y
# CONFIG_LOG_BACKEND_SHOW_COLOR=y
# CONFIG_LOG_INFO_COLOR_GREEN=y
# CONFIG_LOG_OUTPUT_FORMAT_LINUX_TIMESTAMP=y
# CONFIG_NET_LOG=y
# CONFIG_TFTP_LOG_LEVEL_DBG=y

# about thread
CONFIG_MAIN_STACK_SIZE=161920
# CONFIG_THREAD_STACK_INFO=y
# CONFIG_DYNAMIC_THREAD=y
# CONFIG_DYNAMIC_THREAD_POOL_SIZE=128
# CONFIG_DYNAMIC_THREAD_ALLOC=y
# CONFIG_HEAP_MEM_POOL_SIZE=16777216
# CONFIG_ISR_STACK_SIZE=8192
# CONFIG_DYNAMIC_THREAD_STACK_SIZE=8192
# CONFIG_MAX_PTHREAD_COUNT=64
# CONFIG_SHELL_STACK_SIZE=8192

# opt
# CONFIG_DEBUG_OPTIMIZATIONS=y

# debug & shell
CONFIG_SHELL=y
# CONFIG_BUILD_OUTPUT_HEX=y
# CONFIG_OUTPUT_DISASSEMBLY=y

# CAN - ISOTP
CONFIG_CAN=y
# CONFIG_CAN_SHELL=n
# CONFIG_CAN_MAX_FILTER=5
# CONFIG_CAN_FD_MODE=y
# CONFIG_CAN_AUTO_BUS_OFF_RECOVERY=y
# CONFIG_ISOTP=y
# We have two receiving contexts that are bound to a single address.
# CONFIG_ISOTP_RX_SF_FF_BUF_COUNT=2
# CONFIG_ISOTP_BS_TIMEOUT=200
# CONFIG_ISOTP_A_TIMEOUT=200
# CONFIG_ISOTP_CR_TIMEOUT=200
# CONFIG_ISOTP_RX_BUF_COUNT=128
# CONFIG_SAMPLE_LOOPBACK_MODE=y
# CONFIG_V_ISOTP=y

CONFIG_SYSTEM_WORKQUEUE_STACK_SIZE=16384
```

## lib/isotp/Kconfig
```kconfig
# Copyright (c) 2021, Legrand North America, LLC.
# SPDX-License-Identifier: Apache-2.0

config VISOTP
	bool "Support for custom library"
	help
	  This option enables the 'custom' library

if VISOTP

module = VISOTP
module-str = visotp
source "subsys/logging/Kconfig.template.log_config"

endif # VISOTP

config VISOTP_BUF_SIZE
	int "Size of one buffer data block"
	default 64
	help
	  This value defines the size of a single block in the pool. The number of
	  blocks is given by VISOTP_RX_BUF_COUNT / VISOTP_TX_BUF_COUNT. To be efficient use a multiple of
	  CAN_MAX_DLEN - 1 (for classic CAN : 8 - 1 = 7, for CAN-FD : 64 - 1 = 63).

config VISOTP_RX_BUF_COUNT
	int "Number of data buffers for receiving data"
	default 4
	help
	  Each data buffer will occupy VISOTP_BUF_SIZE + smallish
	  header (sizeof(struct net_buf)) amount of data.

config VISOTP_TX_BUF_COUNT
	int "Number of data buffers for sending data"
	default 4
	help
	  Each data buffer will occupy VISOTP_BUF_SIZE + smallish
	  header (sizeof(struct net_buf)) amount of data. If context buffers
	  are used, use the same size here.

config VISOTP_BS_TIMEOUT
	int "Bs timeout [ms] (timeout for receiving the frame control)"
	default 1000
	range 200 10000
	help
	  Timeout for the reception of the next FC frame. ISO 15765-2: 1000ms

config VISOTP_A_TIMEOUT
	int "Ar and As timeout [ms] (sending and receiving timeout)"
	default 1000
	range 200 10000
	help
	  As (sender transmit timeout) and Ar (receiver transmit timeout).
	  ISO 15765-2: 1000ms

config VISOTP_CR_TIMEOUT
	int "Cr timeout [ms] (timeout for consecutive frames)"
	default 200
	range 10 200
	help
	  Cr (receiver consecutive frame) timeout.
```

## lib/isotp_conn/Kconfig
```kconfig
# Copyright (c) 2021, Legrand North America, LLC.
# SPDX-License-Identifier: Apache-2.0


config VISOTP_CONN
	bool "Support for custom library"
	help
	  This option enables the 'custom' library

if VISOTP_CONN

module = VISOTP_CONN
module-str = visotp_conn
source "subsys/logging/Kconfig.template.log_config"

endif # VISOTP_CONN

# config VISOTP_BUF_SIZE
# 	int "Size of one buffer data block"
# 	default 63 if CAN_FD_MODE
# 	default 56
# 	help
# 	  This value defines the size of a single block in the pool. The number of
# 	  blocks is given by VISOTP_RX_BUF_COUNT / VISOTP_TX_BUF_COUNT. To be efficient use a multiple of
# 	  CAN_MAX_DLEN - 1 (for classic CAN : 8 - 1 = 7, for CAN-FD : 64 - 1 = 63).

# config VISOTP_RX_BUF_COUNT
# 	int "Number of data buffers for receiving data"
# 	default 4
# 	help
# 	  Each data buffer will occupy VISOTP_BUF_SIZE + smallish
# 	  header (sizeof(struct net_buf)) amount of data.

# config VISOTP_TX_BUF_COUNT
# 	int "Number of data buffers for sending data"
# 	default 4
# 	help
# 	  Each data buffer will occupy VISOTP_BUF_SIZE + smallish
# 	  header (sizeof(struct net_buf)) amount of data. If context buffers
# 	  are used, use the same size here.

# config VISOTP_BS_TIMEOUT
# 	int "Bs timeout [ms] (timeout for receiving the frame control)"
# 	default 1000
# 	range 200 10000
# 	help
# 	  Timeout for the reception of the next FC frame. ISO 15765-2: 1000ms

# config VISOTP_A_TIMEOUT
# 	int "Ar and As timeout [ms] (sending and receiving timeout)"
# 	default 1000
# 	range 200 10000
# 	help
# 	  As (sender transmit timeout) and Ar (receiver transmit timeout).
# 	  ISO 15765-2: 1000ms

# config VISOTP_CR_TIMEOUT
# 	int "Cr timeout [ms] (timeout for consecutive frames)"
# 	default 200
# 	range 10 200
# 	help
# 	  Cr (receiver consecutive frame) timeout.





# config VISOTP_WFTMAX
# 	int "WFTmax (Max WAIT frames before aborting)."
# 	default 10
# 	range 0 254
# 	help
# 	  This value defines the maximum number of WAIT frames before the transmission
# 	  is aborted.

# config VISOTP_REQUIRE_RX_PADDING
# 	bool "Require padding for received messages"
# 	help
# 	  If enabled, SFs, FCs and the last CF must always have a DLC of 8 bytes
# 	  (for classic CAN) and unused bytes must be padded by the sending
# 	  device. This setting allows to be compliant to AUTOSAR Specification
# 	  of CAN Transport Layer.

# 	  By default, received CAN frames with or without padding are accepted.

# config VISOTP_ENABLE_TX_PADDING
# 	bool "Padding for transmitted messages"
# 	default y if VISOTP_REQUIRE_RX_PADDING
# 	help
# 	  Add padding bytes 0xCC (as recommended by Bosch) if the PDU payload
# 	  does not fit exactly into the CAN frame.

# config VISOTP_RX_SF_FF_BUF_COUNT
# 	int "Number of SF and FF data buffers for receiving data"
# 	default 4
# 	help
# 	  This buffer is used for first and single frames. It is extra because the
# 	  buffer has to be ready for the first reception in isr context and therefor
# 	  is allocated when binding.
# 	  Each buffer will occupy CAN_MAX_DLEN - 1 byte + header (sizeof(struct net_buf))
# 	  amount of data.

# config VISOTP_USE_TX_BUF
# 	bool "Buffer tx writes"
# 	help
# 	  Copy the outgoing data to a net buffer so that the calling function
# 	  can discard the data.

# config VISOTP_BUF_TX_DATA_POOL_SIZE
# 	int "Size of the memory pool where buffers are allocated from"
# 	default 256
# 	help
# 	  This value defines the size of the memory pool where the buffers
# 	  for sending are allocated from.

# config VISOTP_ENABLE_CONTEXT_BUFFERS
# 	bool "Buffered tx contexts"
# 	default y
# 	help
# 	  This option enables buffered sending contexts. This makes send and
# 	  forget possible. A memory slab is used to buffer the context.

# config VISOTP_TX_CONTEXT_BUF_COUNT
# 	int "Amount of context buffers for sending data"
# 	default 4
# 	depends on VISOTP_ENABLE_CONTEXT_BUFFERS
# 	help
# 	  This defines the size of the memory slab where the buffers are
# 	  allocated from.

# config VISOTP_CUSTOM_FIXED_ADDR
# 	bool "Use fixed address not compatible with SAE J1939"
# 	default n
# 	help
# 	  This option allow to use an alternative CAN frame id format.
# 	  If not set ISO-TP fixed addressing use SAE J1939 standard.

# menu "Fixed address definition"
# 	visible if VISOTP_CUSTOM_FIXED_ADDR

# config VISOTP_FIXED_ADDR_SA_POS
# 	int "Position of fixed source address (SA)"
# 	default 0
# 	help
# 	  Source address position in bits.

# config VISOTP_FIXED_ADDR_SA_MASK
# 	hex "Mask to obtain fixed source address (SA)"
# 	default 0xFF
# 	help
# 	  Source address mask.

# config VISOTP_FIXED_ADDR_TA_POS
# 	int "Position of fixed target address (TA)"
# 	default 8
# 	help
# 	  Target address position in bits.

# config VISOTP_FIXED_ADDR_TA_MASK
# 	hex "Mask to obtain fixed target address (TA)"
# 	default 0xFF00
# 	help
# 	  Target address mask.

# config VISOTP_FIXED_ADDR_PRIO_POS
# 	int "Position of priority in fixed addressing mode"
# 	default 26
# 	help
# 	  Priority address position in bits.

# config VISOTP_FIXED_ADDR_PRIO_MASK
# 	hex "Mask for priority in fixed addressing mode"
# 	default 0x1C000000
# 	help
# 	  Priority address mask.

# config VISOTP_FIXED_ADDR_RX_MASK
# 	hex "CAN filter RX mask to match any priority and source address (SA)"
# 	default 0x03FFFF00
# 	help
# 	  CAN filter RX mask

# endmenu
```

## west.yml
```yaml
# Copyright (c) 2021 Nordic Semiconductor ASA
# SPDX-License-Identifier: Apache-2.0

manifest:
  self:
    west-commands: scripts/west-commands.yml

  remotes:
    - name: zephyrproject-rtos
      url-base: https://github.com/zephyrproject-rtos

  projects:
    - name: zephyr
      remote: zephyrproject-rtos
      # revision: v3.6.0
      revision: v3.7.0-rc2
      import:
        # By using name-allowlist we can clone only the modules that are
        # strictly needed by the application.
        name-allowlist:
          - acpica
          - cmsis
          - cmsis-dsp
          - cmsis-nn
          - edtt
          - fatfs
          - hal_adi
          - hal_altera
          - hal_ambiq
          - hal_espressif
          - hal_ethos_u
          - hal_gigadevice
          - hal_infineon
          - hal_intel
          - hal_microchip
          - hal_nordic
          - hal_nuvoton
          - hal_nxp
          - hal_openisa
          - hal_quicklogic
          - hal_renesas
          - hal_rpi_pico
          - hal_silabs
          - hal_st
          - hal_stm32
          - hal_telink
          - hal_ti
          - hal_wurthelektronik
          - hal_xtensa
          - hostap
          - libmetal
          - liblc3
          - littlefs
          - loramac-node
          - lvgl
          - mbedtls
          - mcuboot
          - mipi-sys-t
          - net-tools
          - nrf_hw_models
          - open-amp
          - openthread
          - percepio
          - picolibc
          - segger
          - tinycrypt
          - trusted-firmware-m
          - trusted-firmware-a
          - uoscore-uedhoc
          - zcbor
```
